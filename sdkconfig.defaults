## sdkconfig.defaults
```kconfig
# Rust often needs a bit of an extra main task stack size compared to C (the default is 3K)
CONFIG_ESP_MAIN_TASK_STACK_SIZE=8000

# Use this to set FreeRTOS kernel tick frequency to 1000 Hz (100 Hz by default).
# This allows to use 1 ms granuality for thread sleeps (10 ms by default).
CONFIG_FREERTOS_HZ=1000

# Workaround for https://github.com/espressif/esp-idf/issues/7631
#CONFIG_MBEDTLS_CERTIFICATE_BUNDLE=n
#CONFIG_MBEDTLS_CERTIFICATE_BUNDLE_DEFAULT_FULL=n

#CONFIG_ESP_SYSTEM_EVENT_TASK_STACK_SIZE=4096

#CONFIG_FREERTOS_UNICORE=n

#CONFIG_ESP_INT_WDT=n
#CONFIG_ESP_TASK_WDT_EN=n

#CONFIG_LWIP_ETHARP_TRUST_IP_MAC=n
#CONFIG_LWIP_IRAM_OPTIMIZATION=y

#esp32s3 specific

#CONFIG_ESP_WIFI_STATIC_RX_BUFFER_NUM=24
#CONFIG_ESP_WIFI_DYNAMIC_RX_BUFFER_NUM=64
#CONFIG_ESP_WIFI_DYNAMIC_TX_BUFFER_NUM=64
#CONFIG_ESP_WIFI_AMPDU_TX_ENABLED=y
#CONFIG_ESP_WIFI_TX_BA_WIN=32
#CONFIG_ESP_WIFI_AMPDU_RX_ENABLED=y
#CONFIG_ESP_WIFI_RX_BA_WIN=32

#CONFIG_LWIP_TCP_SND_BUF_DEFAULT=65535
#CONFIG_LWIP_TCP_WND_DEFAULT=65535
#CONFIG_LWIP_TCP_RECVMBOX_SIZE=64
#CONFIG_LWIP_UDP_RECVMBOX_SIZE=64
#CONFIG_LWIP_TCPIP_RECVMBOX_SIZE=64

#CONFIG_ESP_DEFAULT_CPU_FREQ_MHZ_240=y
#CONFIG_ESP_DEFAULT_CPU_FREQ_MHZ=240

# this config causes problems with nvs driver from esp-idf-svc, cannot write or read. Simply brings None with no error
#CONFIG_ESPTOOLPY_FLASHMODE_QIO=y
#CONFIG_ESPTOOLPY_FLASHFREQ_80M=y

#CONFIG_ESP32S3_INSTRUCTION_CACHE_32KB=y
#CONFIG_ESP32S3_INSTRUCTION_CACHE_LINE_32B=y
#CONFIG_ESP32S3_INSTRUCTION_CACHE_WRAP=y
```
